## package/gt/Config.in
```kconfig
config BR2_PACKAGE_GT
    bool "gt (USB gadget config tool)"
    select BR2_PACKAGE_LIBUSBGX
    select BR2_PACKAGE_LIBCONFIG
    help
      USB gadget configuration tool using configfs.
      (http://github.com/linux-usb-gadgets/gt)

if BR2_PACKAGE_GT

config BR2_PACKAGE_GT_GADGETD
    bool "Enable gadgetd support"
    help
      Enable building gt with gadgetd (glib/gio) support.

endif
```

## package/hping/Config.in
```kconfig
config BR2_PACKAGE_HPING
	bool "hping"
	depends on BR2_USE_MMU # Needs fork/exec
	help
	  hping is a command-line oriented TCP/IP packet assembler/analyzer.

	  This version uses a modern Autotools-based build system and supports
	  static linking, cross-compilation, and optional Tcl scripting.
```

## package/oh-my-bash/Config.in
```kconfig
config BR2_PACKAGE_OHMYBASH
    bool "oh-my-bash"
    depends on BR2_PACKAGE_BASH
    help
      Install Oh My Bash into /root/.oh-my-bash like the official install script.
```

## package/yersinia/Config.in
```kconfig
config BR2_PACKAGE_YERSINIA
	bool "yersinia"
	depends on BR2_USE_MMU # due to fork, pthreads
	depends on BR2_TOOLCHAIN_HAS_THREADS
	select BR2_PACKAGE_LIBPCAP
	select BR2_PACKAGE_LIBNET
	select BR2_PACKAGE_NCURSES
	help
	  Yersinia is a Layer 2 network attack tool designed to exploit
	  some weaknesses in different Layer 2 protocols.

	  It supports CDP, Cisco VLAN, DTP, STP, VTP, ISL, DHCP, HSRP, etc.

	  https://github.com/KaliAssistant/yersinia
```
